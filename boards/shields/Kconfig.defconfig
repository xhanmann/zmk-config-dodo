## boards/shields/Kconfig.defconfig
```kconfig
# This file defines default configuration settings for the BRIZY shield.
# Ensure compatibility with central and split roles.

if SHIELD_BRIZY_LEFT

config ZMK_KEYBOARD_NAME
    default "brizy"

config ZMK_SPLIT_ROLE_CENTRAL
    default y

endif

if SHIELD_BRIZY_LEFT || SHIELD_BRIZY_RIGHT

config ZMK_SPLIT
    default y

endif
```

## boards/shields/Kconfig.shield
```kconfig
config SHIELD_BRIZY_LEFT
    def_bool $(shields_list_contains,brizy_left)

config SHIELD_BRIZY_RIGHT
    def_bool $(shields_list_contains,brizy_right)
    
```
